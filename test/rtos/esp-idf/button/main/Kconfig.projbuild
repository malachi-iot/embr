## test/rtos/esp-idf/button/main/Kconfig.projbuild
```kconfig
menu "Embr Button Test"
    config WIFI_ENABLED
        bool "Try to sign onto WiFi network"

    config TIMER_CRASH_DIAGNOSTIC
        bool "Sorting out nasty FreeRTOS timer glitch"

    choice
        prompt "Test mode"

        config POLLED_MODE
            bool "polled"

        config ISR_MODE
            bool "isr"

    endchoice

    choice
        prompt "ISR mode (inactive, always callback - keeping for Kconfig reference)"
        depends on ISR_MODE

        config ISR_LOW_LEVEL_MODE
            bool "low level"

        config ISR_CALLBACK_MODE
            bool "callback"

    endchoice
            
            

    menu "GPIO"

        config BUTTON_PIN
            int "Pin on which debounced button is tested"
            default 0

        config DRIVER_MODE
            bool "Use driver supported per-GPIO ISRs"

    endmenu

endmenu
```

## test/rtos/esp-idf/button/sdkconfig.defaults
```kconfig
CONFIG_ESP_TASK_WDT=y
# CONFIG_ESP_TASK_WDT_PANIC is not set
CONFIG_ESP_TASK_WDT_TIMEOUT_S=5
# CONFIG_ESP_TASK_WDT_CHECK_IDLE_TASK_CPU0 is not set
# CONFIG_ESP_TASK_WDT_CHECK_IDLE_TASK_CPU1 is not set
# CONFIG_ESP_PANIC_HANDLER_IRAM is not set
# CONFIG_ESP_DEBUG_STUBS_ENABLE is not set
# CONFIG_ESP_SYSTEM_CHECK_INT_LEVEL_5 is not set
CONFIG_ESP_SYSTEM_CHECK_INT_LEVEL_4=y
# end of ESP System Settings
```

## test/rtos/esp-idf/debounce/main/Kconfig.projbuild
```kconfig
menu "Debounce Test"

    config DIAGNOSTIC_GPIO1
        int "#1 GPIO to evaluate input on"
        default 2 if IDF_TARGET_ESP32C3
        default 0 if IDF_TARGET_ESP32

    config DIAGNOSTIC_PERFMON
        bool "Performance profiling"
        default y if IDF_TARGET_ESP32
        default n if IDF_TARGET_ESP32C3

endmenu
```

## test/rtos/esp-idf/scheduler/main/Kconfig.projbuild
```kconfig
menu "Embr Scheduler Test"

    menu "LEDs"
        config FAST_LED_PIN
            int "Pin on which to blink quickly but intermittently"
            default 4

        config SLOW_LED_PIN
            int "Pin on which to blink slowly and steadily"
            default 2
    endmenu

    menu "FreeRTOS"
        config EMBR_SCHEDULER_TASKSIZE
            int "Size of stack on which EMBR scheduler daemon runs"
            default 4096

        config EMBR_SCHEDULER_PRIORITY
            int "Priority of EMBR scheduler daemon task"
            default 4
            help
                It is recommended to set this to a relatively high value.
                Scheduler operations are expected to behave similar to an ISR, to come
                and go as quickly as possible leaving heavy processing for other tasks
    endmenu

endmenu
```

## test/rtos/esp-idf/services/adc/main/Kconfig.projbuild
```kconfig
menu "Embr Services Test: ADC"

    # DEBT: Not used yet
    config DIAGNOSTIC_ADC
        int "Which ADC channel to focus on"
        default 0

endmenu
```

## test/rtos/esp-idf/services/esp-now/main/Kconfig.projbuild
```kconfig
menu "Embr Services Test: ESP-NOW"

    config ESPNOW_LMK
        string "Local master key"
        help
            Length must be 16 bytes exactly

    config ESPNOW_PMK
        string "Primary master key"
        help
            Length must be 16 bytes exactly

endmenu
```

## test/rtos/esp-idf/services/gpio/main/Kconfig.projbuild
```kconfig
menu "Embr Services Test: GPIO"

    config DIAGNOSTIC_GPIO1
        int "#1 GPIO to evaluate input on"
        default 2 if IDF_TARGET_ESP32C3
        default 39 if IDF_TARGET_ESP32

endmenu
```

## test/rtos/esp-idf/services/ledc/main/Kconfig.projbuild
```kconfig
menu "Embr Services Test: LED Control"

    config LEDC_OUTPUT_IO
        int "IO #1 to test LEDC/PWM on"
        default 3

endmenu
```

## test/rtos/esp-idf/services/twai/main/Kconfig.projbuild
```kconfig
menu "Embr Services Test: TWAI"

    config TWAI_TEST_TASK
        bool "Use TWAI service worker FreeRTOS task"
        default n


endmenu
```

## test/rtos/esp-idf/services/wifi_provisioner/sdkconfig.defaults
```kconfig
# WiFi provisioner bringing in BLE is surprisingly big
CONFIG_PARTITION_TABLE_SINGLE_APP_LARGE=y

CONFIG_BT_ENABLED=y
CONFIG_BT_NIMBLE_ENABLED=y

CONFIG_LOG_DEFAULT_LEVEL_DEBUG=y
```

## tools/esp-idf/components/embr/Kconfig.projbuild
```kconfig
menu "Embr config"

    menu "FreeRTOS + EMBR scheduler"
        config EMBR_FREERTOS_SCHEDULER_TASKSIZE
            int "Size of stack on which EMBR scheduler daemon runs"
            default 4096

        config EMBR_FREERTOS_SCHEDULER_PRIORITY
            int "Priority of EMBR scheduler daemon task"
            default 4
            help
                It is recommended to set this to a relatively high value.
                Scheduler operations are expected to behave similar to an ISR, to come
                and go as quickly as possible leaving heavy processing for other tasks
    endmenu

    menu "esp-idf"

        menu "High Resolution Timer Scheduler"

            config EMBR_ESP_IDF_TIMER_PROFILING
                bool "Turn on or off esp-idf Timer Scheduler ISR profiler"
                default 0

        endmenu

        menu "Logging Groups"
        #menuconfig M
        #if M
            #help
            #    Value of 0 = disabled
            #    Value of 1 = normal logging
            #    Value of 2 = ISR logging 
            # Cannot get help text to work for the life of me here
                    
            config EMBR_LOG_GROUP_0
                int "Log Group 0"
                range 0 2
                default 0

            config EMBR_LOG_GROUP_1
                int "Log Group 1"
                range 0 2
                default 0

            config EMBR_LOG_GROUP_2
                int "Log Group 2"
                range 0 2
                default 0
                    
            config EMBR_LOG_GROUP_3
                int "Log Group 3"
                range 0 2
                default 0

            config EMBR_LOG_GROUP_4
                int "Log Group 4"
                range 0 2
                default 0

            help
                hello
        #endif
        endmenu

    endmenu

endmenu
```
