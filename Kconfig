## test/esp-idf/unity/main/Kconfig.projbuild
```kconfig
menu "embr::unity config"

    config EMBR_UNITY_SCHEDULER_TEST
        bool "Test time-sensitive scheduler"
        default n
        help
            Scheduler doesn't usually pass unit test due to expected deviations in timing.

    config EMBR_QEMU_MODE
        bool "Hard 'exit()' after tests"
        default false

endmenu
```

## test/rtos/esp-idf/components/esp_helper/Kconfig.projbuild
```kconfig
menu "Embr Helper config"

    menu "WiFi Network"
        config WIFI_SSID
            string "WiFi SSID Name"

        config WIFI_PASSWORD
            string "WiFi Password"
    endmenu

    #menu "Peripherals"

        # DEBT: Probably we want this in Embr component proper, not helper
        # As per https://stackoverflow.com/questions/31325785/is-it-possible-to-convert-a-choice-to-an-int-in-kconfig
        
        # DEBT: Experimenting with this here, probably prefer this in traits.  However,
        # useful for manual config
        menuconfig SDMMC_ENABLED
            bool "SDMMC Card"
            default y if BOARD_ESP32S3_SEEED_XIAO || BOARD_ESP32S3_FREENOVE

        if SDMMC_ENABLED
            config IO_SDMMC_D0
                int "SDMMC data 0 pin (D0)"
                default 8 if BOARD_ESP32S3_SEEED_XIAO
                default 40 if BOARD_ESP32S3_FREENOVE

            config IO_SDMMC_CMD
                int "SDMMC command pin (CMD)"
                default 9 if BOARD_ESP32S3_SEEED_XIAO
                default 38 if BOARD_ESP32S3_FREENOVE

            config IO_SDMMC_CLK
                int "SDMMC clock pin (CLK)"
                default 7 if BOARD_ESP32S3_SEEED_XIAO
                default 39 if BOARD_ESP32S3_FREENOVE
        endif

    #endmenu

endmenu
```

## tools/esp-idf/components/embr/Kconfig
```kconfig
menu "Embr config"

    menu "FreeRTOS + EMBR scheduler"
        config EMBR_FREERTOS_SCHEDULER_TASKSIZE
            int "Size of stack on which EMBR scheduler daemon runs"
            default 4096

        config EMBR_FREERTOS_SCHEDULER_PRIORITY
            int "Priority of EMBR scheduler daemon task"
            default 4
            help
                It is recommended to set this to a relatively high value.
                Scheduler operations are expected to behave similar to an ISR, to come
                and go as quickly as possible leaving heavy processing for other tasks
    endmenu

    menu "esp-idf"

        menu "High Resolution Timer Scheduler"

            config EMBR_ESP_IDF_TIMER_PROFILING
                bool "Timer Scheduler ISR profiler"
                default 0
                help
                    Turn on or off esp-idf Timer Scheduler ISR profiler, which collects
                    a few timestamps of the lifecycle of the ISR then renders them via ESP_DRAM_LOGI

        endmenu

        menu "Logging Groups"
        #menuconfig M
        #if M
            #help
            #    Value of 0 = disabled
            #    Value of 1 = normal logging
            #    Value of 2 = ISR logging 
            # Cannot get help text to work for the life of me here
                    
            config EMBR_LOG_GROUP_0
                int "Log Group 0"
                range 0 2
                default 0

            config EMBR_LOG_GROUP_1
                int "Log Group 1"
                range 0 2
                default 0

            config EMBR_LOG_GROUP_2
                int "Log Group 2"
                range 0 2
                default 0
                    
            config EMBR_LOG_GROUP_3
                int "Log Group 3"
                range 0 2
                default 0

            config EMBR_LOG_GROUP_4
                int "Log Group 4"
                range 0 2
                default 0

            help
                hello
        #endif
        endmenu

    endmenu

    # Thank you https://esp32.com/viewtopic.php?t=17736 for 'rsource' knowledge
    
    # Not an esp-idf convention per se, I am putting my own commonly used settings here
    choice
        prompt "Select Development Board"

        config BOARD_ESP32_UNSPECIFIED
            bool "Unspecified Target"

        rsource "Kconfigs/targets"
    endchoice

    rsource "Kconfigs/twai"
    rsource "Kconfigs/dsp"

    #choice
    #    prompt "Expansion / Carrier"
    #endchoice

    config FORM_FACTOR_XIAO
        int
        default 1 if BOARD_ESP32S3_SEEED_XIAO || BOARD_ESP32C3_SEEED_XIAO || BOARD_ESP32C6_SEEED_XIAO
        default 1 if BOARD_ESP32S3_LILYGO_T_QT_PRO
        default 0

    config FORM_FACTOR_FEATHER
        int
        default 1 if BOARD_ESP32S3_UM_FEATHERS3
        default 1 if BOARD_ESP32S3_ADAFRUIT_FEATHER_REVTFT
        default 1 if BOARD_ESP32C6_SPARKFUN_THINGPLUS
        default 0

endmenu
```
